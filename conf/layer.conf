## conf/layer.conf
```bitbake
# We have a conf and classes directory, add to BBPATH
BBPATH .= ":${LAYERDIR}"

# We have recipes-* directories, add to BBFILES
BBFILES += "${LAYERDIR}/recipes-*/*/*.bb \
            ${LAYERDIR}/recipes-*/*/*.bbappend"

BBFILE_COLLECTIONS += "meta-sle-2026"
BBFILE_PATTERN_meta-sle-2026 = "^${LAYERDIR}/"
BBFILE_PRIORITY_meta-sle-2026 = "6"

META_SLE-2026_BASE := "${LAYERDIR}"

LAYERDEPENDS_meta-sle-2026 = "core"
LAYERSERIES_COMPAT_meta-sle-2026 = " walnascar"
```
